## board/boundary/imx8mp_nitrogen_smarc/Kconfig
```kconfig
if TARGET_IMX8MP_NITROGEN_SMARC

config DEFCONFIG
        string "unknown"

config SYS_BOARD
	default "imx8mp_nitrogen_smarc"

config SYS_VENDOR
	default "boundary"

config SYS_CONFIG_NAME
	default "imx8mp_nitrogen_smarc"

config IMX_CONFIG
        default "board/boundary/imx8mp_nitrogen_smarc/imximage-8mp.cfg"

# source "board/boundary/common/Kconfig"

endif
```
